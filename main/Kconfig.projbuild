## main/Kconfig.projbuild
```kconfig
menu "Board Selection"

    choice BOARD_TARGET
        prompt "Target board"
        default BOARD_M5STACK_BASIC_V27

        config BOARD_M5STACK_BASIC_V27
            bool "M5Stack Basic v2.7 (ESP32)"

        config BOARD_WAVESHARE_S3_LCD19
            bool "Waveshare ESP32-S3-LCD-1.9 (ESP32-S3)"
    endchoice

endmenu

menu "GPS Configuration"

    config GPS_UART_NUM
        int "UART port number for GPS"
        default 2 if BOARD_M5STACK_BASIC_V27
        default 1 if BOARD_WAVESHARE_S3_LCD19
        range 0 2
        help
            UART port number used for GPS communication.

    config GPS_UART_BAUD_RATE
        int "GPS UART baud rate"
        default 115200 if BOARD_M5STACK_BASIC_V27
        default 9600   if BOARD_WAVESHARE_S3_LCD19
        help
            Baud rate for GPS UART communication.

    config GPS_UART_TX_PIN
        int "GPS UART TX GPIO pin"
        default 17 if BOARD_M5STACK_BASIC_V27
        default 18 if BOARD_WAVESHARE_S3_LCD19
        range 0 48
        help
            GPIO number for GPS UART TX (ESP to GPS).

    config GPS_UART_RX_PIN
        int "GPS UART RX GPIO pin"
        default 16 if BOARD_M5STACK_BASIC_V27
        default 17 if BOARD_WAVESHARE_S3_LCD19
        range 0 48
        help
            GPIO number for GPS UART RX (GPS to ESP).

endmenu

menu "UI Options"

    choice UI_STATUS_WARN_STYLE
        prompt "SD card / battery warning style"
        default UI_STATUS_WARN_BACKGROUND
        help
            How the Main Screen marks a low SD card or battery value of a
            camera slot. Thresholds (both styles): SD card <= 16 GB free
            yellow, <= 6 GB red; battery <= 25 % yellow, <= 10 % red.

            Build-time only: there is no runtime or user-facing switch. A
            board sdkconfig.defaults.* file may override the default.

        config UI_STATUS_WARN_BACKGROUND
            bool "Row background"
            help
                The whole status row gets a yellow or red background across
                the slot width; text and icon turn black (yellow) or white
                (red).

        config UI_STATUS_WARN_TINT
            bool "Text/icon tint (legacy)"
            help
                Only the row's text and icon are tinted yellow or red
                (behavior before plan 0019).
    endchoice

endmenu
```
