## sdkconfig.defaults
```kconfig
# Configuration for M5Stack Basic V2.7 (ESP32)
#
CONFIG_IDF_TARGET="esp32"

# Bluetooth configuration (NimBLE stack)
CONFIG_BT_ENABLED=y
CONFIG_BT_NIMBLE_ENABLED=y
CONFIG_BT_NIMBLE_MAX_CONNECTIONS=4
CONFIG_BT_NIMBLE_ROLE_CENTRAL=y
CONFIG_BT_NIMBLE_ROLE_OBSERVER=y
CONFIG_BT_NIMBLE_ROLE_BROADCASTER=y
CONFIG_BT_NIMBLE_ROLE_PERIPHERAL=y
CONFIG_BT_NIMBLE_GATT_SERVER=y
CONFIG_BT_NIMBLE_NVS_PERSIST=y
CONFIG_BT_NIMBLE_ATT_PREFERRED_MTU=500
CONFIG_BT_BLE_50_FEATURES_SUPPORTED=n
CONFIG_BT_BLE_42_FEATURES_SUPPORTED=y

# Disable NimBLE security to match original Bluedroid behavior (no encryption).
# DJI cameras may withhold notifications if they detect the client supports
# encryption but never initiates pairing.
CONFIG_BT_NIMBLE_SECURITY_ENABLE=n
CONFIG_BT_NIMBLE_SM_LEGACY=n
CONFIG_BT_NIMBLE_SM_SC=n

# Flash configuration for M5Stack Basic V2.7 (16MB Flash)
CONFIG_ESPTOOLPY_FLASHSIZE_16MB=y
CONFIG_ESPTOOLPY_FLASHSIZE="16MB"
CONFIG_ESPTOOLPY_FLASHMODE_DIO=y
CONFIG_ESPTOOLPY_FLASHFREQ_80M=y

# CPU frequency
CONFIG_ESP32_DEFAULT_CPU_FREQ_240=y
CONFIG_ESP32_DEFAULT_CPU_FREQ_MHZ=240

# FreeRTOS
CONFIG_FREERTOS_HZ=1000
CONFIG_FREERTOS_TIMER_TASK_STACK_DEPTH=4096
CONFIG_ESP_MAIN_TASK_STACK_SIZE=8192

# SPI Configuration for Display
CONFIG_SPI_MASTER_ISR_IN_IRAM=y

# UART Configuration for GPS
CONFIG_UART_ISR_IN_IRAM=y

# Power Management
CONFIG_PM_ENABLE=y

# Partition Table - Custom table with 2MB app partition for LVGL + boot logo
CONFIG_PARTITION_TABLE_CUSTOM=y
CONFIG_PARTITION_TABLE_CUSTOM_FILENAME="partitions.csv"

# LVGL core
CONFIG_LV_COLOR_DEPTH_16=y
CONFIG_LV_DEF_REFR_PERIOD=33
CONFIG_LV_DPI_DEF=130

# Do NOT place LVGL code in IRAM -- ESP32 IRAM is tight with BLE stack
CONFIG_LV_ATTRIBUTE_FAST_MEM_USE_IRAM=n

# Disable unused features to save RAM/flash
CONFIG_LV_USE_BIDI=n
CONFIG_LV_USE_ARABIC_PERSIAN_CHARS=n
CONFIG_LV_USE_SYSMON=n
CONFIG_LV_USE_PERF_MONITOR=n

# Fonts: Montserrat 12 (small), 14 (body) and 16 (headings)
CONFIG_LV_FONT_MONTSERRAT_12=y
CONFIG_LV_FONT_MONTSERRAT_14=y
CONFIG_LV_FONT_MONTSERRAT_16=y
CONFIG_LV_FONT_DEFAULT_MONTSERRAT_14=y

# Board selector
CONFIG_BOARD_M5STACK_BASIC_V27=y

# GPS configuration for M5Stack Basic v2.7
CONFIG_GPS_UART_NUM=2
CONFIG_GPS_UART_BAUD_RATE=115200
CONFIG_GPS_UART_TX_PIN=17
CONFIG_GPS_UART_RX_PIN=16
```

## sdkconfig.defaults.waveshare_s3_lcd19
```kconfig
# Configuration for Waveshare ESP32-S3-LCD-1.9
#
CONFIG_IDF_TARGET="esp32s3"

# Board selector
CONFIG_BOARD_WAVESHARE_S3_LCD19=y

# PSRAM — 8 MB OPI PSRAM on ESP32-S3R8
CONFIG_SPIRAM=y
CONFIG_SPIRAM_MODE_OCT=y
CONFIG_SPIRAM_SPEED_80M=y
CONFIG_SPIRAM_USE_MALLOC=y

# Flash — 16 MB W25Q128
CONFIG_ESPTOOLPY_FLASHSIZE_16MB=y
CONFIG_ESPTOOLPY_FLASHSIZE="16MB"
CONFIG_ESPTOOLPY_FLASHMODE_DIO=y
CONFIG_ESPTOOLPY_FLASHFREQ_80M=y

# Console — ESP32-S3 built-in USB Serial/JTAG
CONFIG_ESP_CONSOLE_USB_SERIAL_JTAG=y

# CPU — ESP32-S3 dual-core LX7
CONFIG_ESP32S3_DEFAULT_CPU_FREQ_240=y
CONFIG_ESP32S3_DEFAULT_CPU_FREQ_MHZ=240

# FreeRTOS
CONFIG_FREERTOS_HZ=1000
CONFIG_FREERTOS_TIMER_TASK_STACK_DEPTH=4096

# Main task stack — app_main() runs BLE init, LVGL init, UI creation,
# and the main event loop all on this stack.  The default 3584 is too
# small for ESP32-S3 and causes periodic stack overflow crashes.
CONFIG_ESP_MAIN_TASK_STACK_SIZE=8192

# Bluetooth (NimBLE — identical settings to M5Stack)
CONFIG_BT_ENABLED=y
CONFIG_BT_NIMBLE_ENABLED=y
CONFIG_BT_NIMBLE_MAX_CONNECTIONS=4
CONFIG_BT_NIMBLE_ROLE_CENTRAL=y
CONFIG_BT_NIMBLE_ROLE_OBSERVER=y
CONFIG_BT_NIMBLE_ROLE_BROADCASTER=y
CONFIG_BT_NIMBLE_ROLE_PERIPHERAL=y
CONFIG_BT_NIMBLE_GATT_SERVER=y
CONFIG_BT_NIMBLE_NVS_PERSIST=y
CONFIG_BT_NIMBLE_ATT_PREFERRED_MTU=500
CONFIG_BT_BLE_50_FEATURES_SUPPORTED=y
CONFIG_BT_BLE_42_FEATURES_SUPPORTED=y

# Disable NimBLE security to match original behavior (no encryption)
CONFIG_BT_NIMBLE_SECURITY_ENABLE=n
CONFIG_BT_NIMBLE_SM_LEGACY=n
CONFIG_BT_NIMBLE_SM_SC=n

# GPS configuration for Waveshare + ATGM336H
CONFIG_GPS_UART_NUM=1
CONFIG_GPS_UART_BAUD_RATE=9600
CONFIG_GPS_UART_TX_PIN=18
CONFIG_GPS_UART_RX_PIN=17

# SPI / UART ISR in IRAM
CONFIG_SPI_MASTER_ISR_IN_IRAM=y
CONFIG_UART_ISR_IN_IRAM=y

# Power Management
CONFIG_PM_ENABLE=y

# Partition table — reuse same custom table
CONFIG_PARTITION_TABLE_CUSTOM=y
CONFIG_PARTITION_TABLE_CUSTOM_FILENAME="partitions.csv"

# LVGL (same as M5Stack)
CONFIG_LV_COLOR_DEPTH_16=y
CONFIG_LV_DEF_REFR_PERIOD=33
CONFIG_LV_DPI_DEF=130
CONFIG_LV_ATTRIBUTE_FAST_MEM_USE_IRAM=n
CONFIG_LV_USE_BIDI=n
CONFIG_LV_USE_ARABIC_PERSIAN_CHARS=n
CONFIG_LV_USE_SYSMON=n
CONFIG_LV_USE_PERF_MONITOR=n
CONFIG_LV_FONT_MONTSERRAT_12=y
CONFIG_LV_FONT_MONTSERRAT_14=y
CONFIG_LV_FONT_MONTSERRAT_16=y
CONFIG_LV_FONT_DEFAULT_MONTSERRAT_14=y
```
